## CMakeLists.txt
```
include($ENV{ZEPHYR_BASE}/cmake/app/boilerplate.cmake NO_POLICY_SCOPE)
project(NONE)

target_sources(app PRIVATE
  src/main.c
  src/rpl.c
)

include($ENV{ZEPHYR_BASE}/samples/net/common/common.cmake)

target_include_directories(app PRIVATE $ENV{ZEPHYR_BASE}/subsys/net/ip)
```

## prj.conf
```kconfig
CONFIG_MAIN_STACK_SIZE=2048
CONFIG_SYSTEM_WORKQUEUE_STACK_SIZE=2048

CONFIG_BT_DEBUG_LOG=y

CONFIG_BT_CTLR=n
CONFIG_BT_H4=y
CONFIG_STDOUT_CONSOLE=n
CONFIG_UART_CONSOLE=n
CONFIG_HAS_SEGGER_RTT=y
CONFIG_RTT_CONSOLE=y
CONFIG_GPIO=y
CONFIG_SERIAL=y
CONFIG_UART_INTERRUPT_DRIVEN=y
CONFIG_UART_NRF5_FLOW_CONTROL=y

CONFIG_BT_OBSERVER=y
CONFIG_BT_BROADCASTER=y
CONFIG_BT_RX_BUF_COUNT=20

CONFIG_BT_MESH=y
CONFIG_BT_MESH_RELAY=y
CONFIG_BT_MESH_SUBNET_COUNT=1
CONFIG_BT_MESH_APP_KEY_COUNT=2
CONFIG_BT_MESH_MODEL_GROUP_COUNT=2
CONFIG_BT_MESH_ADV_BUF_COUNT=20
CONFIG_BT_MESH_PB_ADV=n
CONFIG_BT_MESH_CFG_CLI=y
CONFIG_BT_MESH_RX_SDU_MAX=48
CONFIG_BT_MESH_TX_SEG_MSG_COUNT=2
CONFIG_BT_MESH_RX_SEG_MSG_COUNT=2

#CONFIG_BT_MESH_DEBUG=y
#CONFIG_BT_MESH_DEBUG_NET=y
#CONFIG_BT_MESH_DEBUG_ACCESS=y

CONFIG_UART_NRF5_GPIO_TX_PIN=34
CONFIG_UART_NRF5_GPIO_RX_PIN=36
CONFIG_UART_NRF5_GPIO_RTS_PIN=33
CONFIG_UART_NRF5_GPIO_CTS_PIN=35

##Networking
CONFIG_NETWORKING=y

CONFIG_ENTROPY_GENERATOR=y
CONFIG_TEST_RANDOM_GENERATOR=y

CONFIG_NET_PKT_RX_COUNT=15
CONFIG_NET_PKT_TX_COUNT=15
CONFIG_NET_BUF_RX_COUNT=25
CONFIG_NET_BUF_TX_COUNT=25

CONFIG_NET_IPV6=y
CONFIG_NET_IPV6_RA_RDNSS=n
CONFIG_NET_IF_UNICAST_IPV6_ADDR_COUNT=3
CONFIG_NET_IF_MCAST_IPV6_ADDR_COUNT=4
CONFIG_NET_IF_IPV6_PREFIX_COUNT=5

CONFIG_NET_IPV6_ND=n
CONFIG_NET_IPV6_DAD=y
CONFIG_NET_IPV6_MLD=n

CONFIG_NET_UDP=y

CONFIG_NET_6LO=y
CONFIG_NET_6LO_CONTEXT=y
CONFIG_NET_MAX_6LO_CONTEXTS=3

CONFIG_NET_LOG=y
CONFIG_SYS_LOG_SHOW_COLOR=y
CONFIG_SYS_LOG_NET_LEVEL=4
CONFIG_INIT_STACKS=n
CONFIG_PRINTK=y

#CONFIG_NET_BUF_LOG=n
#CONFIG_SYS_LOG_NET_BUF_LEVEL=1

CONFIG_COAP=y
CONFIG_COAP_WELL_KNOWN_BLOCK_WISE=y
CONFIG_COAP_WELL_KNOWN_BLOCK_WISE_SIZE=64
CONFIG_NET_DEBUG_COAP=y

CONFIG_NET_RPL=y
CONFIG_NET_RPL_PROBING=y
CONFIG_NET_ROUTE=y

CONFIG_NET_L2_IEEE802154=y
CONFIG_NET_L2_IEEE802154_FRAGMENT=y
CONFIG_IEEE802154_NRF5=y
CONFIG_IEEE802154_NRF5_DRV_NAME="IEEE802154_nrf5"
CONFIG_IEEE802154_NRF5_INIT_PRIO=80
CONFIG_NET_APP_SETTINGS=y
CONFIG_NET_APP_IEEE802154_CHANNEL=18
CONFIG_NET_APP_IEEE802154_DEV_NAME="IEEE802154_nrf5"

# IP core debug
CONFIG_NET_DEBUG_CORE=n
CONFIG_NET_DEBUG_IPV6_NBR_CACHE=n
CONFIG_NET_DEBUG_IPV6=n
#CONFIG_NET_DEBUG_NET_BUF=n
CONFIG_NET_DEBUG_UTILS=n
CONFIG_NET_DEBUG_IF=n
CONFIG_NET_DEBUG_ICMPV6=n
CONFIG_NET_DEBUG_CONN=n
CONFIG_NET_DEBUG_UDP=n
CONFIG_NET_DEBUG_CONTEXT=n
CONFIG_NET_DEBUG_ROUTE=n
CONFIG_NET_DEBUG_6LO=n
CONFIG_NET_DEBUG_RPL=y

CONFIG_NET_STATISTICS=n
CONFIG_NET_STATISTICS_PERIODIC_OUTPUT=n

# L2 Debug
CONFIG_NET_DEBUG_L2_IEEE802154=n
CONFIG_NET_DEBUG_L2_IEEE802154_FRAGMENT=n
CONFIG_SYS_LOG_IEEE802154_DRIVER_LEVEL=2
```

## src/main.c
```c
/* main.c - Application main entry point */

/*
 * Copyright (c) 2017 Intel Corporation
 *
 * SPDX-License-Identifier: Apache-2.0
 */

#include <misc/printk.h>

#include <bluetooth/bluetooth.h>
#include <bluetooth/mesh.h>

#include "rpl.h"

#define COMP_ID BT_COMP_ID_LF

#define MOD_LF 0x0000

#define NODE_ADDR 0x0001
#define GROUP_ADDR 0xc000

#define OP_VENDOR_BUTTON BT_MESH_MODEL_OP_3(0x00, COMP_ID)

static const u8_t net_key[16] = {
	0x01, 0x23, 0x45, 0x67, 0x89, 0xab, 0xcd, 0xef,
	0x01, 0x23, 0x45, 0x67, 0x89, 0xab, 0xcd, 0xef,
};
static const u8_t dev_key[16] = {
	0x01, 0x23, 0x45, 0x67, 0x89, 0xab, 0xcd, 0xef,
	0x01, 0x23, 0x45, 0x67, 0x89, 0xab, 0xcd, 0xef,
};
static const u8_t app_key[16] = {
	0x01, 0x23, 0x45, 0x67, 0x89, 0xab, 0xcd, 0xef,
	0x01, 0x23, 0x45, 0x67, 0x89, 0xab, 0xcd, 0xef,
};
static const u16_t net_idx;
static const u16_t app_idx;
static const u32_t iv_index;
static u8_t flags;

static struct bt_mesh_cfg_srv cfg_srv = {
	.relay = BT_MESH_RELAY_ENABLED,
	.beacon = BT_MESH_BEACON_ENABLED,
	.frnd = BT_MESH_FRIEND_NOT_SUPPORTED,
	.default_ttl = 7,

	/* 3 transmissions with 20ms interval */
	.net_transmit = BT_MESH_TRANSMIT(2, 20),
	.relay_retransmit = BT_MESH_TRANSMIT(3, 20),
};

static struct bt_mesh_cfg_cli cfg_cli = {
};

static void attention_on(struct bt_mesh_model *model)
{
	printk("attention_on()\n");
}

static void attention_off(struct bt_mesh_model *model)
{
	printk("attention_off()\n");
}

static const struct bt_mesh_health_srv_cb health_srv_cb = {
	.attn_on = attention_on,
	.attn_off = attention_off,
};

static struct bt_mesh_health_srv health_srv = {
	.cb = &health_srv_cb,
};

BT_MESH_HEALTH_PUB_DEFINE(health_pub, 0);

static struct bt_mesh_model sig_models[] = {
	BT_MESH_MODEL_CFG_SRV(&cfg_srv),
	BT_MESH_MODEL_CFG_CLI(&cfg_cli),
	BT_MESH_MODEL_HEALTH_SRV(&health_srv, &health_pub),
};

static void vnd_button_pressed(struct bt_mesh_model *model,
			       struct bt_mesh_msg_ctx *ctx,
			       struct net_buf_simple *buf)
{
	//printk("Message 0x%04x -> 0x%04x\n", ctx->addr, model->elem->addr);

	ble_to_rpl(ctx->addr, model->elem->addr);
}

static const struct bt_mesh_model_op vnd_ops[] = {
	{ OP_VENDOR_BUTTON, 0, vnd_button_pressed },
	BT_MESH_MODEL_OP_END,
};

static struct bt_mesh_model vnd1_models[] = {
	BT_MESH_MODEL_VND(COMP_ID, MOD_LF, vnd_ops, NULL, NULL),
};

static struct bt_mesh_model vnd2_models[] = {
	BT_MESH_MODEL_VND(COMP_ID, MOD_LF, vnd_ops, NULL, NULL),
};

static struct bt_mesh_model vnd3_models[] = {
	BT_MESH_MODEL_VND(COMP_ID, MOD_LF, vnd_ops, NULL, NULL),
};

static struct bt_mesh_model vnd4_models[] = {
	BT_MESH_MODEL_VND(COMP_ID, MOD_LF, vnd_ops, NULL, NULL),
};

static struct bt_mesh_elem elements[] = {
	BT_MESH_ELEM(0, sig_models, vnd1_models),
	BT_MESH_ELEM(0, BT_MESH_MODEL_NONE, vnd2_models),
	BT_MESH_ELEM(0, BT_MESH_MODEL_NONE, vnd3_models),
	BT_MESH_ELEM(0, BT_MESH_MODEL_NONE, vnd4_models),
};

static const struct bt_mesh_comp comp = {
	.cid = COMP_ID,
	.elem = elements,
	.elem_count = ARRAY_SIZE(elements),
};

int rpl_to_ble(u16_t src, u16_t dst)
{
	struct bt_mesh_model *model;
	NET_BUF_SIMPLE_DEFINE(msg, 3 + 4);
	struct bt_mesh_msg_ctx ctx = {
		.net_idx = net_idx,
		.app_idx = app_idx,
		.addr = dst,
		.send_ttl = BT_MESH_TTL_DEFAULT,
	};

	printk("src 0x%04x dst 0x%04x\n", src, dst);

	if (src >= ARRAY_SIZE(elements)) {
		return -EINVAL;
	}

	model = &elements[src].vnd_models[0];

	/* Bind to Health model */
	bt_mesh_model_msg_init(&msg, OP_VENDOR_BUTTON);

	if (bt_mesh_model_send(model, &ctx, &msg, NULL, NULL)) {
		printk("Unable to send Vendor Button message\n");
		return -EIO;
	}

	printk("Button message sent with OpCode 0x%08x\n", OP_VENDOR_BUTTON);

	return 0;
}

static void configure(u16_t addr)
{
	u8_t status;

	/* Add Application Key */
	bt_mesh_cfg_app_key_add(net_idx, addr, net_idx, app_idx, app_key,
				&status);

	/* Bind to vendor model */
	bt_mesh_cfg_mod_app_bind_vnd(net_idx, addr, addr, app_idx,
				     MOD_LF, COMP_ID, &status);
	bt_mesh_cfg_mod_app_bind_vnd(net_idx, addr, addr + 1, app_idx,
				     MOD_LF, COMP_ID, &status);
	bt_mesh_cfg_mod_app_bind_vnd(net_idx, addr, addr + 2, app_idx,
				     MOD_LF, COMP_ID, &status);
	bt_mesh_cfg_mod_app_bind_vnd(net_idx, addr, addr + 3, app_idx,
				     MOD_LF, COMP_ID, &status);

	/* Bind to Health model */
	bt_mesh_cfg_mod_app_bind(net_idx, addr, addr, app_idx,
				 BT_MESH_MODEL_ID_HEALTH_SRV, &status);

	/* Add model subscription */
	bt_mesh_cfg_mod_sub_add_vnd(net_idx, addr, addr, GROUP_ADDR,
				    MOD_LF, COMP_ID, &status);
	bt_mesh_cfg_mod_sub_add_vnd(net_idx, addr, addr + 1, GROUP_ADDR,
				    MOD_LF, COMP_ID, &status);
	bt_mesh_cfg_mod_sub_add_vnd(net_idx, addr, addr + 2, GROUP_ADDR,
				    MOD_LF, COMP_ID, &status);
	bt_mesh_cfg_mod_sub_add_vnd(net_idx, addr, addr + 3, GROUP_ADDR,
				    MOD_LF, COMP_ID, &status);
}

static const u8_t dev_uuid[16] = { 0xdd, 0xdd };

static const struct bt_mesh_prov prov = {
	.uuid = dev_uuid,
};

void main(void)
{
	int err;

	/* Set up 802.15.4 RPL proxy */
	printk("Initializing RPL proxy...\n");

	init_rpl_node();

	printk("Initializing Bluetooth...\n");

	/* Initialize the Bluetooth Subsystem */
	err = bt_enable(NULL);
	if (err) {
		printk("Bluetooth init failed (err %d)\n", err);
		return;
	}

	printk("Bluetooth initialized\n");

	err = bt_mesh_init(&prov, &comp);
	if (err) {
		printk("Initializing mesh failed (err %d)\n", err);
		return;
	}

	printk("Mesh initialized\n");

	err = bt_mesh_provision(net_key, net_idx, flags, iv_index, 0,
				NODE_ADDR, dev_key);
	if (err) {
		printk("Provisioning failed (err %d)\n", err);
		return;
	}

	printk("Provisioning completed, configuring...\n");

	configure(NODE_ADDR);

	printk("Configuring complete\n");
}
```

## src/rpl.c
```c
#if 1
#define SYS_LOG_DOMAIN "rpl-node"
#define NET_SYS_LOG_LEVEL SYS_LOG_LEVEL_DEBUG
#define NET_LOG_ENABLED 1
#endif

#include <zephyr.h>
#include <errno.h>
#include <board.h>
#include <gpio.h>

#include <net/net_core.h>
#include <net/net_ip.h>
#include <net/net_pkt.h>
#include <net/net_context.h>
#include <net/udp.h>
#include <net/coap.h>

#include <net_private.h>
#include <rpl.h>

#include "rpl.h"

#define MY_COAP_PORT 5683
#define PEER_COAP_PORT 0xABC0

#define ALL_NODES_LOCAL_COAP_MCAST					\
	{ { { 0xff, 0x02, 0, 0, 0, 0, 0, 0, 0, 0, 0, 0, 0, 0, 0, 0xfd } } }

#define RPL_MAX_REPLY 75

#define PKT_WAIT_TIME K_SECONDS(1)

static struct net_context *context;

static const char * const uri_path[] = { "led", NULL };

static bool send_coap_request(const struct sockaddr_in6 *peer, u16_t id,
			      u8_t src, u8_t dst)
{
	struct net_pkt *pkt;
	struct net_buf *frag;
	struct coap_packet request;
	const char * const *p;
	int r;

	pkt = net_pkt_get_tx(context, PKT_WAIT_TIME);
	if (!pkt) {
		NET_ERR("Ran out of network packets");
		return false;
	}

	frag = net_pkt_get_data(context, PKT_WAIT_TIME);
	if (!frag) {
		NET_ERR("Ran out of network buffers");
		goto end;
	}

	net_pkt_frag_add(pkt, frag);

	r = coap_packet_init(&request, pkt, 1, COAP_TYPE_NON_CON,
			     0, NULL, COAP_METHOD_POST, id);
	if (r < 0) {
		NET_ERR("Failed to initialize CoAP packet");
		goto end;
	}

	for (p = uri_path; p && *p; p++) {
		r = coap_packet_append_option(&request, COAP_OPTION_URI_PATH,
					      *p, strlen(*p));
		if (r < 0) {
			NET_ERR("Unable add option to request.\n");
			goto end;
		}
	}

	r = coap_packet_append_payload_marker(&request);
	if (r < 0) {
		net_pkt_unref(pkt);
		return false;
	}

	/* Append SRC id */
	r = coap_packet_append_payload(&request, &src, 1);
	if (r < 0) {
		net_pkt_unref(pkt);
		return false;
	}

	/* Append DST id */
	r = coap_packet_append_payload(&request, &dst, 1);
	if (r < 0) {
		net_pkt_unref(pkt);
		return false;
	}

	r = net_context_sendto(pkt, (const struct sockaddr *)peer,
			       sizeof(struct sockaddr_in6),
			       NULL, 0, NULL, NULL);
	if (r < 0) {
		NET_ERR("Cannot send data to peer (%d)", r);
		goto end;
	}

	return true;

end:
	net_pkt_unref(pkt);
	return false;
}

int ble_to_rpl(u16_t src, u16_t dst)
{
	struct net_rpl_instance *rpl;
	struct sockaddr_in6 peer;
	struct in6_addr *parent = NULL;

	/* Send message in below combinations only
	 * src -> dst
	 *  5  ->  1
	 *  6  ->  2
	 *  7  ->  3
	 *  8  ->  4
	 */

	if (!((src == 5 && dst == 1) ||
	      (src == 6 && dst == 2) ||
	      (src == 7 && dst == 3) ||
	      (src == 8 && dst == 4))) {
		return 0;
	}

	NET_DBG("Message 0x%04x -> 0x%04x", src, dst);

	rpl = net_rpl_get_default_instance();
	if (rpl && rpl->current_dag && rpl->current_dag->preferred_parent) {
		parent = net_rpl_get_parent_addr(net_if_get_default(),
					 rpl->current_dag->preferred_parent);
		if (!parent) {
			NET_DBG("Can not send CoAP req to RPL BR");
			return -EINVAL;
		}
	} else {
		return -EINVAL;
	}

	peer.sin6_family = AF_INET6;
	peer.sin6_port = PEER_COAP_PORT;
	net_ipaddr_copy(&peer.sin6_addr, parent);

	return send_coap_request(&peer, coap_next_id(), src, dst);
}

static int led_post(struct coap_resource *resource,
		    struct coap_packet *request)
{
	struct net_buf *frag;
	u16_t offset;
	u8_t src;
	u8_t dst;

	NET_DBG("");

	frag = net_frag_skip(request->frag, request->offset, &offset,
			     request->hdr_len + request->opt_len);
	if (!frag && offset == 0xffff) {
		return -EINVAL;
	}

	frag = net_frag_read_u8(frag, offset, &offset, &src);
	if (!frag && offset == 0xffff) {
		NET_ERR("packet without payload");
	}

	frag = net_frag_read_u8(frag, offset, &offset, &dst);
	if (!frag && offset == 0xffff) {
		NET_ERR("packet without payload");
	}

	NET_DBG("Message from %d -> %d", src, dst);

	rpl_to_ble(src, dst);

	return 0;
}

static const char * const led_default_path[] = { "led", NULL };

static struct coap_resource resources[] = {
	{ .get = NULL,
	  .post = led_post,
	  .put = NULL,
	  .path = led_default_path,
	  .user_data = NULL,
	},
	{ },
};

static void udp_receive(struct net_context *context,
			struct net_pkt *pkt,
			int status,
			void *user_data)
{
	struct coap_packet request;
	struct coap_option options[16] = { 0 };
	u8_t opt_num = 16;
	int r;

	r = coap_packet_parse(&request, pkt, options, opt_num);
	if (r < 0) {
		NET_ERR("Invalid data received (%d)\n", r);
		goto end;
	}

	r = coap_handle_request(&request, resources, options, opt_num);
	if (r < 0) {
		NET_ERR("No handler for such request (%d)\n", r);
	}

end:
	net_pkt_unref(pkt);
}

static bool join_coap_multicast_group(void)
{
	static struct sockaddr_in6 mcast_addr = {
		.sin6_family = AF_INET6,
		.sin6_addr = ALL_NODES_LOCAL_COAP_MCAST,
		.sin6_port = htons(MY_COAP_PORT) };
	struct net_if_mcast_addr *mcast;
	struct net_if *iface;

	iface = net_if_get_default();
	if (!iface) {
		NET_ERR("Could not get te default interface\n");
		return false;
	}

	mcast = net_if_ipv6_maddr_add(iface, &mcast_addr.sin6_addr);
	if (!mcast) {
		NET_ERR("Could not add multicast address to interface\n");
		return false;
	}

	return true;
}

void init_rpl_node(void)
{
	static struct sockaddr_in6 any_addr = {
		.sin6_family = AF_INET6,
		.sin6_addr = IN6ADDR_ANY_INIT,
		.sin6_port = htons(MY_COAP_PORT) };
	int r;

	if (!join_coap_multicast_group()) {
		NET_ERR("Could not join CoAP multicast group");
		return;
	}

	r = net_context_get(AF_INET6, SOCK_DGRAM, IPPROTO_UDP, &context);
	if (r) {
		NET_ERR("Could not get an UDP context");
		return;
	}

	r = net_context_bind(context, (struct sockaddr *) &any_addr,
			     sizeof(any_addr));
	if (r) {
		NET_ERR("Could not bind the context");
		return;
	}

	r = net_context_recv(context, udp_receive, 0, NULL);
	if (r) {
		NET_ERR("Could not receive in the context");
	}
}
```

## src/rpl.h
```c
void init_rpl_node(void);
```
