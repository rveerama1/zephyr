## CMakeLists.txt
```
include($ENV{ZEPHYR_BASE}/cmake/app/boilerplate.cmake NO_POLICY_SCOPE)
project(NONE)

FILE(GLOB app_sources src/*.c)
target_sources(app PRIVATE ${app_sources})

include($ENV{ZEPHYR_BASE}/samples/net/common/common.cmake)

target_include_directories(app PRIVATE $ENV{ZEPHYR_BASE}/subsys/net/ip)
```

## prj.conf
```kconfig
# Note that this configuration file does not provide usable system.
# It is only used to verify the compilation of the application.

# Generic IP stack options and features
CONFIG_NETWORKING=y
CONFIG_NET_TCP=y
CONFIG_NET_UDP=y
CONFIG_RANDOM_GENERATOR=y
CONFIG_NET_LOG=y
CONFIG_INIT_STACKS=y
CONFIG_NET_SHELL=y
CONFIG_NET_STATISTICS=y
CONFIG_NET_MAX_CONTEXTS=8
CONFIG_NET_IPV6=y
CONFIG_NET_IPV4=y
#CONFIG_NET_DHCPV4=y

# Number of network buffers
CONFIG_NET_PKT_RX_COUNT=128
CONFIG_NET_PKT_TX_COUNT=128
CONFIG_NET_BUF_RX_COUNT=128
CONFIG_NET_BUF_TX_COUNT=128

# IPv6 address counts
CONFIG_NET_IF_UNICAST_IPV6_ADDR_COUNT=4
CONFIG_NET_IF_MCAST_IPV6_ADDR_COUNT=5

# IPv6 neighbors/routes count
CONFIG_NET_IPV6_MAX_NEIGHBORS=8

# RPL and routing options
CONFIG_NET_RPL=y
CONFIG_NET_ROUTE=y
CONFIG_NET_ROUTING=y
# This is used as a prefix when creating DAG.
CONFIG_NET_RPL_PREFIX="fd77:d528:ae6a:6df6::1/64"

# HTTP(S) admin interface
CONFIG_HTTP=y
CONFIG_HTTPS=n
CONFIG_HTTP_APP=y
CONFIG_NET_APP_SERVER=y
CONFIG_HTTP_SERVER=y
# Firefox sends lot of fields so this needs to be quite large
CONFIG_HTTP_HEADERS=20
CONFIG_HTTP_SERVER_NUM_URLS=8
CONFIG_WEBSOCKET=y

# Crypto support
CONFIG_MBEDTLS=y
CONFIG_MBEDTLS_BUILTIN=y
CONFIG_MBEDTLS_CFG_FILE="config-mini-tls1_2.h"
CONFIG_MBEDTLS_ENABLE_HEAP=y
CONFIG_MBEDTLS_HEAP_SIZE=30000

# Logging
CONFIG_SYS_LOG_SHOW_COLOR=y
CONFIG_SYS_LOG_NET_LEVEL=1

# Debugging
CONFIG_NET_DEBUG_WEBSOCKET=y
CONFIG_NET_DEBUG_HTTP=y
CONFIG_NET_DEBUG_HTTP_CONN=y
CONFIG_NET_DEBUG_RPL=y
CONFIG_NET_DEBUG_ROUTE=y

# Network application settings
CONFIG_NET_APP_SETTINGS=y
CONFIG_NET_APP_NEED_IPV6=y
CONFIG_NET_APP_NEED_IPV4=y
# This is the ethernet interface setting for admin purposes
CONFIG_NET_APP_MY_IPV6_ADDR="2001:db8::1"
CONFIG_NET_APP_MY_IPV4_ADDR="192.0.2.1"
```

## prj_nrf52840_pca10056.conf
```kconfig
# Generic IP stack options and features
CONFIG_NETWORKING=y
CONFIG_NET_TCP=y
CONFIG_NET_UDP=y
CONFIG_ENTROPY_GENERATOR=y
CONFIG_TEST_RANDOM_GENERATOR=y
CONFIG_NET_LOG=y
CONFIG_INIT_STACKS=y
CONFIG_NET_SHELL=y
CONFIG_NET_STATISTICS=y
CONFIG_NET_MAX_CONTEXTS=16
CONFIG_NET_IPV6=y
CONFIG_NET_IPV4=y
#CONFIG_NET_DHCPV4=y

CONFIG_NET_RX_STACK_SIZE=2048
CONFIG_NET_DEBUG_NET_PKT_EXTERNALS=2000

# Number of network buffers
CONFIG_NET_PKT_RX_COUNT=128
CONFIG_NET_PKT_TX_COUNT=128
CONFIG_NET_BUF_RX_COUNT=128
CONFIG_NET_BUF_TX_COUNT=128

# IPv6 address counts
CONFIG_NET_IF_UNICAST_IPV6_ADDR_COUNT=4
CONFIG_NET_IF_MCAST_IPV6_ADDR_COUNT=5

# IPv6 neighbors/routes count. This determines how many nodes
# our RPL network can have.
CONFIG_NET_IPV6_MAX_NEIGHBORS=20

# RPL and routing options
CONFIG_NET_RPL=y
CONFIG_NET_ROUTE=y
CONFIG_NET_ROUTING=y
CONFIG_NET_RPL_L2_IEEE802154=y
# This is used as a prefix when creating DAG. You can pick your own
# prefix here, better not to use this exact value.
CONFIG_NET_RPL_PREFIX="fde3:2cda:3eea:4d14::1/64"

# HTTP(S) admin and websocket interface support
CONFIG_HTTP=y
CONFIG_HTTPS=n
CONFIG_HTTP_SERVER=y
CONFIG_HTTP_SERVER_NUM_URLS=8
CONFIG_WEBSOCKET=y
CONFIG_WEBSOCKET_CONSOLE=y

# Allow two concurrent incoming connections
CONFIG_NET_TCP_BACKLOG_SIZE=1
CONFIG_NET_APP_SERVER_NUM_CONN=2

CONFIG_NET_TCP_INIT_RETRANSMISSION_TIMEOUT=50=5000
CONFIG_NET_TCP_ACK_TIMEOUT=2000

# Crypto support
CONFIG_MBEDTLS=y
CONFIG_MBEDTLS_BUILTIN=y
CONFIG_MBEDTLS_CFG_FILE="config-mini-tls1_2.h"
CONFIG_MBEDTLS_ENABLE_HEAP=y
CONFIG_MBEDTLS_HEAP_SIZE=12000

# Logging
CONFIG_SYS_LOG_SHOW_COLOR=y
CONFIG_SYS_LOG_NET_LEVEL=4
CONFIG_SYS_LOG_IEEE802154_DRIVER_LEVEL=2

# Debugging
CONFIG_NET_DEBUG_NET_PKT=n
CONFIG_NET_DEBUG_WEBSOCKET=n
CONFIG_NET_DEBUG_RPL=n
CONFIG_NET_DEBUG_ROUTE=n
CONFIG_NET_DEBUG_APP=n
CONFIG_NET_DEBUG_IPV6=n
CONFIG_NET_DEBUG_IPV6_NBR_CACHE=n
CONFIG_NET_DEBUG_CONTEXT=n
CONFIG_NET_DEBUG_TCP=y
CONFIG_NET_DEBUG_CORE=n
CONFIG_NET_DEBUG_CONN=n
CONFIG_NET_DEBUG_IF=n
CONFIG_NET_DEBUG_HTTP=n
CONFIG_MBEDTLS_DEBUG=n
CONFIG_NET_DEBUG_ROUTE=n

# Network application settings
CONFIG_NET_APP_SETTINGS=y
CONFIG_NET_APP_NEED_IPV6=y
CONFIG_NET_APP_NEED_IPV4=y
# This is the ethernet interface setting for admin purposes
CONFIG_NET_APP_MY_IPV6_ADDR="2001:db8::1"
CONFIG_NET_APP_MY_IPV4_ADDR="192.0.2.1"

# Set a proper hostname for the router
CONFIG_NET_HOSTNAME_ENABLE=y

# mDNS support is activated. After this one can connect to this device
# by zephyr.local name
CONFIG_MDNS_RESPONDER=y

# IEEE 802.15.4 options
CONFIG_IEEE802154_NRF5=y
CONFIG_IEEE802154_NRF5_DRV_NAME="IEEE802154_nrf5"
CONFIG_IEEE802154_NRF5_INIT_PRIO=80
CONFIG_NET_L2_IEEE802154_SHELL=y
CONFIG_NET_L2_IEEE802154=y
CONFIG_NET_L2_IEEE802154_FRAGMENT=y
CONFIG_NET_APP_IEEE802154_CHANNEL=18
CONFIG_NET_APP_IEEE802154_DEV_NAME="IEEE802154_nrf5"

# IPv6 compression is needed for IEEE 802.15.4
CONFIG_NET_6LO=y
CONFIG_NET_6LO_CONTEXT=y

#COAP
CONFIG_COAP=y

#MGMT
CONFIG_NET_MGMT=y
CONFIG_NET_MGMT_EVENT=y
CONFIG_NET_MGMT_EVENT_INFO=y
CONFIG_NET_MGMT_EVENT_STACK_SIZE=768
CONFIG_NET_MGMT_EVENT_QUEUE_SIZE=8

#JSON
CONFIG_JSON_LIBRARY=y

CONFIG_NET_DEFAULT_IF_BLUETOOTH=y

#Bluetooth
CONFIG_BT=y
CONFIG_BT_DEBUG_LOG=y
CONFIG_BT_DEBUG_L2CAP=y
CONFIG_BT_SMP=y
CONFIG_BT_SIGNING=y
CONFIG_BT_PERIPHERAL=y
CONFIG_BT_L2CAP_DYNAMIC_CHANNEL=y
CONFIG_BT_DEVICE_NAME="Test IPSP node"
CONFIG_NET_L2_BT=y
CONFIG_NET_APP_BT_NODE=y
```

## prj_quark_se_c1000_devboard.conf
```kconfig
# Generic IP stack options and features
CONFIG_NETWORKING=y
CONFIG_NET_UDP=y
CONFIG_ENTROPY_GENERATOR=y
CONFIG_NET_LOG=y
CONFIG_INIT_STACKS=y
CONFIG_NET_SHELL=y
CONFIG_NET_STATISTICS=y
CONFIG_NET_MAX_CONTEXTS=5
CONFIG_NET_IPV6=y

CONFIG_NET_RX_STACK_SIZE=2048

# Number of network buffers
CONFIG_NET_PKT_RX_COUNT=30
CONFIG_NET_PKT_TX_COUNT=30
CONFIG_NET_BUF_RX_COUNT=30
CONFIG_NET_BUF_TX_COUNT=30

# IPv6 address counts
CONFIG_NET_IF_UNICAST_IPV6_ADDR_COUNT=4
CONFIG_NET_IF_MCAST_IPV6_ADDR_COUNT=5

# IPv6 neighbors/routes count. This determines how many nodes
# our RPL network can have.
CONFIG_NET_IPV6_MAX_NEIGHBORS=12

# RPL and routing options
CONFIG_NET_RPL=y
CONFIG_NET_ROUTE=y
CONFIG_NET_ROUTING=y
CONFIG_NET_RPL_L2_IEEE802154=y
# This is used as a prefix when creating DAG. You can pick your own
# prefix here, better not to use this exact value.
CONFIG_NET_RPL_PREFIX="fde3:2cda:3eea:4d14::1/64"

# Logging
CONFIG_SYS_LOG_SHOW_COLOR=y
CONFIG_SYS_LOG_NET_LEVEL=1
CONFIG_SYS_LOG_IEEE802154_DRIVER_LEVEL=2

# Debugging
CONFIG_NET_DEBUG_NET_PKT=n
CONFIG_NET_DEBUG_WEBSOCKET=n
CONFIG_NET_DEBUG_RPL=n
CONFIG_NET_DEBUG_ROUTE=n
CONFIG_NET_DEBUG_APP=n
CONFIG_NET_DEBUG_IPV6=n
CONFIG_NET_DEBUG_IPV6_NBR_CACHE=n
CONFIG_NET_DEBUG_CONTEXT=n
CONFIG_NET_DEBUG_CORE=n
CONFIG_NET_DEBUG_CONN=n
CONFIG_NET_DEBUG_IF=n
CONFIG_MBEDTLS_DEBUG=n
CONFIG_NET_DEBUG_ROUTE=n

# Network application settings
CONFIG_NET_APP_SETTINGS=y
CONFIG_NET_APP_NEED_IPV6=y
# This is the ethernet interface setting for admin purposes
CONFIG_NET_APP_MY_IPV6_ADDR="2001:db8::1"

# IEEE 802.15.4 options
CONFIG_NET_L2_IEEE802154_SHELL=y
CONFIG_NET_L2_IEEE802154=y
CONFIG_NET_L2_IEEE802154_FRAGMENT=y
CONFIG_NET_APP_IEEE802154_CHANNEL=18
CONFIG_NET_APP_IEEE802154_DEV_NAME="cc2520"
CONFIG_IEEE802154_CC2520=y

# IPv6 compression is needed for IEEE 802.15.4
CONFIG_NET_6LO=y
CONFIG_NET_6LO_CONTEXT=n

#COAP
CONFIG_COAP=y

#MGMT
CONFIG_NET_MGMT=y
CONFIG_NET_MGMT_EVENT=y
CONFIG_NET_MGMT_EVENT_INFO=y
CONFIG_NET_MGMT_EVENT_STACK_SIZE=768
CONFIG_NET_MGMT_EVENT_QUEUE_SIZE=8

CONFIG_IEEE802154_CC2520_RANDOM_MAC=n
CONFIG_IEEE802154_CC2520_MAC4=0x00
CONFIG_IEEE802154_CC2520_MAC5=0x00
CONFIG_IEEE802154_CC2520_MAC6=0x00
CONFIG_IEEE802154_CC2520_MAC7=0x00
```

## src/main.c
```c
/*
 * Copyright (c) 2017 Intel Corporation
 *
 * SPDX-License-Identifier: Apache-2.0
 */

#if 1
#define SYS_LOG_DOMAIN "rpl-br/main"
#define NET_SYS_LOG_LEVEL SYS_LOG_LEVEL_DEBUG
#define NET_LOG_ENABLED 1
#endif

#include <zephyr.h>
#include <stdio.h>

#include <net/net_context.h>
#include <net/net_mgmt.h>
#include <net/net_event.h>

#include "ipv6.h"
#include "route.h"
#include "rpl.h"
#include "net_private.h"
#include "config.h"

/*
static void calculate_edges(void)
{
	u8_t i, j, k;

	k = 0;

	for (i = 1; i < CONFIG_NET_IPV6_MAX_NEIGHBORS; i++) {
		if (!topology.nodes[i].used) {
			continue;
		}

		for (j = 0; j < CONFIG_NET_IPV6_MAX_NEIGHBORS; j++) {
			if (!topology.nodes[j].used) {
				continue;
			}

			if (!net_ipv6_addr_cmp(&topology.nodes[i].parent,
					       &topology.nodes[j].addr)) {
				continue;
			}

			topology.edges[k].from = topology.nodes[i].id;
			topology.edges[k].to = topology.nodes[j].id;
			topology.edges[k].used = true;

			k++;
			break;

		}
	}
}
*/

static void coap_obs_cb(struct coap_packet *response, void *user_data)
{
	ARG_UNUSED(response);
	ARG_UNUSED(user_data);
}

static struct net_mgmt_event_callback br_mgmt_cb;
static void mgmt_cb(struct net_mgmt_event_callback *cb,
		    u32_t mgmt_event, struct net_if *iface)
{
	struct net_if *iface_802154 = net_if_get_ieee802154();
	struct net_event_ipv6_route *route_info;
	struct net_event_ipv6_nbr *nbr_info;
	struct net_route_entry *route;
	struct net_nbr *nbr;

	if (iface_802154 != iface) {
		return;
	}

	if (!cb->info) {
		return;
	}

	if (mgmt_event == NET_EVENT_IPV6_NBR_ADD) {
		nbr_info = (struct net_event_ipv6_nbr *)cb->info;
		if (!nbr_info) {
			NET_ERR("Invalid info received on event");
			return;
		}

		nbr = net_ipv6_nbr_lookup(iface, &nbr_info->addr);
		if (!nbr || !net_ipv6_nbr_data(nbr)) {
			NET_ERR("Invalid neighbor data received");
			return;
		}

		NET_DBG("NBR add %s", net_sprint_ipv6_addr(&nbr_info->addr));

	} else if (mgmt_event == NET_EVENT_IPV6_NBR_DEL) {
		nbr_info = (struct net_event_ipv6_nbr *)cb->info;
		if (!nbr_info) {
			NET_ERR("Invalid info received on event");
			return;
		}

		NET_DBG("NBR del %s", net_sprint_ipv6_addr(&nbr_info->addr));

	} else if (mgmt_event == NET_EVENT_IPV6_ROUTE_ADD) {
		route_info = (struct net_event_ipv6_route *)cb->info;
		if (!route_info) {
			NET_ERR("Invalid info received on event");
			return;
		}

		route = net_route_lookup(iface, &route_info->addr);
		if (!route) {
			NET_ERR("Invalid route entry received");
			return;
		}

		NET_DBG("ROUTE add addr %s/%d",
			net_sprint_ipv6_addr(&route_info->addr),
			route_info->prefix_len);
		{
			NET_DBG("ROUTE add nexthop %s",
				net_sprint_ipv6_addr(&route_info->nexthop));

		}

		coap_send_request(&route_info->nexthop,
				  COAP_REQ_RPL_OBS, coap_obs_cb, NULL);

	} else if (mgmt_event == NET_EVENT_IPV6_ROUTE_DEL) {
		route_info = (struct net_event_ipv6_route *)cb->info;
		if (!route_info) {
			NET_ERR("Invalid info received on event");
			return;
		}

		NET_DBG("ROUTE del addr %s/%d",
			net_sprint_ipv6_addr(&route_info->addr),
			route_info->prefix_len);
		{
			NET_DBG("ROUTE del nexthop %s",
				net_sprint_ipv6_addr(&route_info->nexthop));

		}

		coap_remove_node_from_topology(&route_info->nexthop);
	}
}

void main(void)
{
	struct net_if *iface;

	NET_DBG("RPL border router starting");

	iface = net_if_get_default();
	if (!iface) {
		NET_INFO("Cannot continue, no interface exists");
		return;
	}

	setup_rpl(iface, CONFIG_NET_RPL_PREFIX);

	coap_init();

	net_mgmt_init_event_callback(&br_mgmt_cb, mgmt_cb,
				     NET_EVENT_IPV6_NBR_ADD |
				     NET_EVENT_IPV6_NBR_DEL |
				     NET_EVENT_IPV6_ROUTE_ADD |
				     NET_EVENT_IPV6_ROUTE_DEL);
	net_mgmt_add_event_callback(&br_mgmt_cb);
}
```

## src/coap.c
```c
/*
 * Copyright (c) 2017 Intel Corporation
 *
 * SPDX-License-Identifier: Apache-2.0
 */

#if 1
#define SYS_LOG_DOMAIN "rpl-br/coap"
#define NET_SYS_LOG_LEVEL SYS_LOG_LEVEL_DEBUG
#define NET_LOG_ENABLED 1
#endif

#include <zephyr.h>
#include <stdio.h>
#include <stdlib.h>

#include <net/net_app.h>
#include <net/coap.h>
#include <net/udp.h>

#include "rpl.h"
#include "net_private.h"

#include "config.h"

#define MY_COAP_PORT 0xC0AB
#define PEER_COAP_PORT htons(0x1633) /* 5683 */

#define LED_ON  "1"
#define LED_OFF "0"

#define PKT_WAIT_TIME K_SECONDS(1)
#define WAIT_TIME  K_SECONDS(10)
#define RESPONSE_TIME  K_SECONDS(18)

#define MAX_COAP_REQUEST_ATTEMPTS	5
#define MAX_COAP_REQUESTS		20

struct coap_request {
	struct k_delayed_work timer; /* Timer to retransmit messages */
	struct sockaddr_in6 peer; /* Peer CoAP server socket address */
	u16_t id; /* Message id sent */
	u8_t code; /* Expecting reply code */
	u8_t count; /* Number of trails */
	bool used; /* Entry used or not */
	enum coap_request_type type;
	coap_reply_cb_t cb;
	void *user_data;
};

static struct net_context *coap;
static struct coap_request requests[MAX_COAP_REQUESTS];

static const char * const uri_path[] = { "led", "0",  NULL };
static const char * const rpl_info_path[] = { "rpl-info", NULL };
static const char * const rpl_obs_path[] = { "rpl-obs", NULL };

static void get_from_ip_addr(struct coap_packet *cpkt,
			     struct sockaddr_in6 *from)
{
	struct net_udp_hdr hdr, *udp_hdr;

	udp_hdr = net_udp_get_hdr(cpkt->pkt, &hdr);
	if (!udp_hdr) {
		return;
	}

	net_ipaddr_copy(&from->sin6_addr, &NET_IPV6_HDR(cpkt->pkt)->src);
	from->sin6_port = udp_hdr->src_port;
	from->sin6_family = AF_INET6;
}

static struct coap_request *
get_coap_request_by_type(const struct sockaddr_in6 *peer,
			 enum coap_request_type type)
{
	u8_t i;

	for (i = 0; i < MAX_COAP_REQUESTS; i++) {
		if (!requests[i].used) {
			continue;
		}

		if (requests[i].type == type &&
		    net_ipv6_addr_cmp(&requests[i].peer.sin6_addr,
				      &peer->sin6_addr)) {
			return &requests[i];
		}
	}

	return NULL;
}

static struct coap_request *
get_coap_request_by_id(const struct sockaddr_in6 *peer, u16_t id)
{
	u8_t i;

	for (i = 0; i < MAX_COAP_REQUESTS; i++) {
		if (!requests[i].used) {
			continue;
		}

		if (requests[i].id == id &&
		    net_ipv6_addr_cmp(&requests[i].peer.sin6_addr,
				      &peer->sin6_addr)) {
			return &requests[i];
		}
	}

	return NULL;
}

static struct coap_request *
get_coap_request_by_addr(const struct in6_addr *peer)
{
	u8_t i;

	for (i = 0; i < MAX_COAP_REQUESTS; i++) {
		if (!requests[i].used) {
			continue;
		}

		if (net_ipv6_addr_cmp(&requests[i].peer.sin6_addr, peer)) {
			return &requests[i];
		}
	}

	return NULL;
}

static struct coap_request *get_free_coap_request(void)
{
	int i;

	for (i = 0; i < MAX_COAP_REQUESTS; i++) {
		if (!requests[i].used) {
			return &requests[i];
		}
	}

	return NULL;
}

static void clear_coap_request(struct coap_request *request)
{
	if (!request->used) {
		return;
	}

	request->type = COAP_REQ_NONE;
	request->id = 0;
	request->code = 0;
	request->count = 0;
	request->used = false;
	request->cb = NULL;
	request->user_data = NULL;

	k_delayed_work_cancel(&request->timer);
}

static bool set_led_on(const struct sockaddr_in6 *peer, u16_t id)
{
	struct net_pkt *pkt;
	struct net_buf *frag;
	struct coap_packet request;
	const char * const *p;
	int r;

	pkt = net_pkt_get_tx(coap, PKT_WAIT_TIME);
	if (!pkt) {
		NET_ERR("Ran out of network packets");
		return false;
	}

	frag = net_pkt_get_data(coap, PKT_WAIT_TIME);
	if (!frag) {
		NET_ERR("Ran out of network buffers");
		goto end;
	}

	net_pkt_frag_add(pkt, frag);

	r = coap_packet_init(&request, pkt, 1, COAP_TYPE_CON,
			     0, NULL, COAP_METHOD_PUT, id);
	if (r < 0) {
		NET_ERR("Failed to initialize CoAP packet");
		goto end;
	}

	for (p = uri_path; p && *p; p++) {
		r = coap_packet_append_option(&request, COAP_OPTION_URI_PATH,
					      *p, strlen(*p));
		if (r < 0) {
			NET_ERR("Unable add option to request.\n");
			goto end;
		}
	}

	r = coap_packet_append_payload_marker(&request);
	if (r < 0) {
		NET_ERR("Failed to append payload marker");
		goto end;
	}

	r = coap_packet_append_payload(&request, (u8_t *)LED_ON,
				       strlen(LED_ON));
	if (r < 0) {
		NET_ERR("Failed to append payload marker");
		goto end;
	}

	r = net_context_sendto(pkt, (const struct sockaddr *)peer,
			       sizeof(struct sockaddr_in6),
			       NULL, 0, NULL, NULL);
	if (r < 0) {
		NET_ERR("Cannot send data to peer (%d)", r);
		goto end;
	}

	return true;

end:
	net_pkt_unref(pkt);
	return false;
}

static bool set_led_off(const struct sockaddr_in6 *peer, u16_t id)
{
	struct net_pkt *pkt;
	struct net_buf *frag;
	struct coap_packet request;
	const char * const *p;
	int r;

	pkt = net_pkt_get_tx(coap, PKT_WAIT_TIME);
	if (!pkt) {
		NET_ERR("Ran out of network packets");
		return false;
	}

	frag = net_pkt_get_data(coap, PKT_WAIT_TIME);
	if (!frag) {
		NET_ERR("Ran out of network buffers");
		goto end;
	}

	net_pkt_frag_add(pkt, frag);

	r = coap_packet_init(&request, pkt, 1, COAP_TYPE_CON,
			     0, NULL, COAP_METHOD_PUT, id);
	if (r < 0) {
		NET_ERR("Failed to initialize CoAP packet");
		goto end;
	}

	for (p = uri_path; p && *p; p++) {
		r = coap_packet_append_option(&request, COAP_OPTION_URI_PATH,
					      *p, strlen(*p));
		if (r < 0) {
			NET_ERR("Unable add option to request.\n");
			goto end;
		}
	}

	r = coap_packet_append_payload_marker(&request);
	if (r < 0) {
		NET_ERR("Failed to append payload marker");
		goto end;
	}

	r = coap_packet_append_payload(&request, (u8_t *)LED_OFF,
				       strlen(LED_OFF));
	if (r < 0) {
		NET_ERR("Failed to append payload marker");
		goto end;
	}

	r = net_context_sendto(pkt, (const struct sockaddr *)peer,
			       sizeof(struct sockaddr_in6),
			       NULL, 0, NULL, NULL);
	if (r < 0) {
		NET_ERR("Cannot send data to peer (%d)", r);
		goto end;
	}

	return true;

end:
	net_pkt_unref(pkt);
	return false;
}

static bool get_rpl_info(const struct sockaddr_in6 *peer, u16_t id)
{
	struct net_pkt *pkt;
	struct net_buf *frag;
	struct coap_packet request;
	const char * const *p;
	int r;

	pkt = net_pkt_get_tx(coap, PKT_WAIT_TIME);
	if (!pkt) {
		NET_ERR("Ran out of network packets");
		return false;
	}

	frag = net_pkt_get_data(coap, PKT_WAIT_TIME);
	if (!frag) {
		NET_ERR("Ran out of network buffers");
		goto end;
	}

	net_pkt_frag_add(pkt, frag);

	r = coap_packet_init(&request, pkt, 1, COAP_TYPE_CON,
			     0, NULL, COAP_METHOD_GET, id);
	if (r < 0) {
		NET_ERR("Failed to initialize CoAP packet");
		goto end;
	}

	for (p = rpl_info_path; p && *p; p++) {
		r = coap_packet_append_option(&request, COAP_OPTION_URI_PATH,
					      *p, strlen(*p));
		if (r < 0) {
			NET_ERR("Unable add option to request");
			goto end;
		}
	}

	r = net_context_sendto(pkt, (const struct sockaddr *)peer,
			       sizeof(struct sockaddr_in6),
			       NULL, 0, NULL, NULL);
	if (r < 0) {
		NET_ERR("Cannot send data to peer (%d)", r);
		goto end;
	}

	return true;

end:
	net_pkt_unref(pkt);
	return false;
}

static bool set_rpl_observer(const struct sockaddr_in6 *peer, u16_t id)
{
	struct net_pkt *pkt;
	struct net_buf *frag;
	struct coap_packet request;
	const char * const *p;
	int r;

	pkt = net_pkt_get_tx(coap, PKT_WAIT_TIME);
	if (!pkt) {
		NET_ERR("Ran out of network packets");
		return false;
	}

	frag = net_pkt_get_data(coap, PKT_WAIT_TIME);
	if (!frag) {
		NET_ERR("Ran out of network buffers");
		goto end;
	}

	net_pkt_frag_add(pkt, frag);

	r = coap_packet_init(&request, pkt, 1, COAP_TYPE_CON,
			     8, coap_next_token(),
			     COAP_METHOD_GET, id);
	if (r < 0) {
		NET_ERR("Failed to initialize CoAP packet");
		goto end;
	}

	r = coap_append_option_int(&request, COAP_OPTION_OBSERVE, 0);
	if (r < 0) {
		NET_ERR("Unable add option to request");
		goto end;
	}

	for (p = rpl_obs_path; p && *p; p++) {
		r = coap_packet_append_option(&request, COAP_OPTION_URI_PATH,
					      *p, strlen(*p));
		if (r < 0) {
			NET_ERR("Unable add option to request");
			goto end;
		}
	}

	r = net_context_sendto(pkt, (const struct sockaddr *)peer,
			       sizeof(struct sockaddr_in6),
			       NULL, 0, NULL, NULL);
	if (r < 0) {
		NET_ERR("Cannot send data to peer (%d)", r);
		goto end;
	}

	return true;

end:
	net_pkt_unref(pkt);
	return false;
}

static void request_timeout(struct k_work *work)
{
	struct coap_request *request = CONTAINER_OF(work,
						    struct coap_request,
						    timer);

	if (request->count >= MAX_COAP_REQUEST_ATTEMPTS) {
		/* Reached max number of CoAP requests to this peer */
		clear_coap_request(request);
		return;
	}

	request->count++;

	switch (request->type) {
	case COAP_REQ_NONE:
		return;
	case COAP_REQ_LED_ON:
		set_led_on(&request->peer, request->id);
		break;
	case COAP_REQ_LED_OFF:
		set_led_off(&request->peer, request->id);
		break;
	case COAP_REQ_RPL_INFO:
		get_rpl_info(&request->peer, request->id);
	case COAP_REQ_RPL_OBS:
		set_rpl_observer(&request->peer, request->id);
		break;
	}

	k_delayed_work_submit(&request->timer, RESPONSE_TIME);
}

static void add_nbr_to_topology(struct in6_addr *nbr)
{
	if (topology.nodes[0].used) {
		return;
	}

	topology.nodes[0].id = 1;
	topology.nodes[0].used = true;
	snprintk(topology.nodes[0].label, sizeof(topology.nodes[0].label),
		 "NBR");
	net_ipaddr_copy(&topology.nodes[0].addr, nbr);
}

static void add_node_to_topology(struct in6_addr *node)
{
	u8_t i;

	/* BR takes 'id : 1', so node's id starts from 2 */
	for (i = 1; i < CONFIG_NET_IPV6_MAX_NEIGHBORS; i++) {
		if (topology.nodes[i].used) {
			continue;
		}

		topology.nodes[i].id = i + 1;
		topology.nodes[i].used = true;

		snprintk(topology.nodes[i].label,
			 sizeof(topology.nodes[i].label),
			 "N%d", topology.nodes[i].id);

		net_ipaddr_copy(&topology.nodes[i].addr, node);
		break;
	}
}

static void update_node_topology(struct in6_addr *node,
				 struct in6_addr *parent,
				 u16_t rank)
{
	u8_t i;

	for (i = 0; i < CONFIG_NET_IPV6_MAX_NEIGHBORS; i++) {
		if (!topology.nodes[i].used) {
			continue;
		}

		if (!net_ipv6_addr_cmp(&topology.nodes[i].addr,
				       node)) {
			continue;
		}

		topology.nodes[i].rank = rank;
		net_ipaddr_copy(&topology.nodes[i].parent, parent);
		break;
	}
}

static void remove_node_from_topology(struct in6_addr *node)
{
	u8_t i;

	for (i = 1; i < CONFIG_NET_IPV6_MAX_NEIGHBORS; i++) {
		if (!topology.nodes[i].used) {
			continue;
		}

		if (!net_ipv6_addr_cmp(&topology.nodes[i].addr,
				       node)) {
			continue;
		}

		topology.nodes[i].used = false;
	}
}

#define COAP_REPLY_PARENT strlen("parent-")
#define COAP_REPLY_RANK strlen("rank-")
#define COAP_REPLY_NONE strlen("None")
#define COAP_REPLY_RANK_VALUE 6

#define MAX_PAYLOAD_SIZE (NET_IPV6_ADDR_LEN + \
			  COAP_REPLY_PARENT + \
			  COAP_REPLY_RANK   + \
			  COAP_REPLY_RANK_VALUE)

static void node_obs_reply(struct coap_packet *response, void *user_data)
{
	char payload[MAX_PAYLOAD_SIZE];
	char parent_str[NET_IPV6_ADDR_LEN + 1];
	char rank_str[COAP_REPLY_RANK_VALUE + 1];
	struct sockaddr_in6 from;
	struct in6_addr parent;
	struct net_buf *frag;
	u16_t offset;
	u16_t len;
	u16_t rank;
	u8_t i;

	frag = coap_packet_get_payload(response, &offset, &len);
	if (!frag && offset == 0xffff) {
		NET_ERR("Error while getting payload");
		return;
	}

	if (!len) {
		NET_ERR("Invalid response");
		return;
	}

	frag = net_frag_read(frag, offset, &offset, len, (u8_t *) payload);
	if (!frag && offset == 0xffff) {
		return;
	}

	if (strncmp(payload, "parent-", COAP_REPLY_PARENT)) {
		return;
	}

	if (!strncmp(payload + COAP_REPLY_PARENT, "None", COAP_REPLY_NONE)) {
		return;
	}

	i = 0;
	offset = COAP_REPLY_PARENT;
	while (payload[offset] != '\n') {
		parent_str[i++] = payload[offset++];
	}

	parent_str[i] = '\0';

	i++;
	if (strncmp(payload + COAP_REPLY_PARENT + i, "rank-",
		    COAP_REPLY_RANK)) {
		return;
	}

	if (!strncmp(payload + COAP_REPLY_PARENT + i, "None",
		     COAP_REPLY_NONE)) {
		return;
	}

	offset = COAP_REPLY_PARENT + i + COAP_REPLY_RANK;
	i = 0;
	while (offset < len) {
		rank_str[i++] = payload[offset++];
	}

	rank_str[i] = '\0';

	if (net_addr_pton(AF_INET6, parent_str, &parent) < 0) {
		NET_ERR("Failed to convert parent address");
		return;
	}

	get_from_ip_addr(response, &from);
	rank = atoi(rank_str);

	update_node_topology(&from.sin6_addr, &parent, rank);
}

static void pkt_receive(struct net_context *context,
			struct net_pkt *pkt,
			int status,
			void *user_data)
{
	struct coap_option options[4] = { 0 };
	struct coap_packet response;
	struct coap_request *coap_req;
	struct sockaddr_in6 from;
	u16_t id;
	u8_t type;
	u8_t code;
	u8_t opt_num = 4;
	int r;

	r = coap_packet_parse(&response, pkt, options, opt_num);
	if (r < 0) {
		NET_ERR("Invalid data received (%d)\n", r);
		net_pkt_unref(pkt);
		return;
	}

	type = coap_header_get_type(&response);
	code = coap_header_get_code(&response);
	id  = coap_header_get_id(&response);
	get_from_ip_addr(&response, &from);

	if (type != COAP_TYPE_ACK) {
		NET_ERR("Invalid response, type %d", type);
		net_pkt_unref(pkt);
		return;
	}

	NET_DBG("Received %d bytes coap payload",
		net_pkt_appdatalen(pkt) - response.hdr_len - response.opt_len);

	coap_req = get_coap_request_by_id(&from, id);
	if (!coap_req) {
		net_pkt_unref(pkt);
		return;
	}

	if (code != coap_req->code) {
		NET_ERR("Invalid response, code %d", code);
		goto end;
	}

	if (coap_req->type == COAP_REQ_RPL_OBS) {
		node_obs_reply(&response, coap_req->user_data);
	}

	if (coap_req->cb) {
		coap_req->cb(&response, coap_req->user_data);
	}

end:
	clear_coap_request(coap_req);
	net_pkt_unref(pkt);
}

void coap_remove_node_from_topology(struct in6_addr *peer)
{
	struct coap_request *request;

	request = get_coap_request_by_addr(peer);
	if (request) {
		clear_coap_request(request);
	}

	remove_node_from_topology(peer);
}

void coap_send_request(struct in6_addr *peer_addr,
		       enum coap_request_type type,
		       coap_reply_cb_t cb,
		       void *user_data)
{
	struct sockaddr_in6 peer;
	struct coap_request *request;

	peer.sin6_family = AF_INET6;
	peer.sin6_port = PEER_COAP_PORT;
	net_ipaddr_copy(&peer.sin6_addr, peer_addr);

	request = get_coap_request_by_type(&peer, type);
	if (request) {
		/* Same request already sent, did not get reply from it,
		 * timer will run until requests reach
		 * MAX_COAP_REQUEST_ATTEMPTS.
		 */
		return;
	}

	request = get_free_coap_request();
	if (!request) {
		switch (type) {
		case COAP_REQ_NONE:
			return;
		case COAP_REQ_LED_ON:
			set_led_on(&peer, coap_next_id());
			break;
		case COAP_REQ_LED_OFF:
			set_led_off(&peer, coap_next_id());
			break;
		case COAP_REQ_RPL_INFO:
			get_rpl_info(&peer, coap_next_id());
		case COAP_REQ_RPL_OBS:
			add_node_to_topology(peer_addr);
			set_rpl_observer(&peer, coap_next_id());
			break;
		}

		return;
	}

	request->peer.sin6_family = peer.sin6_family;
	request->peer.sin6_port = peer.sin6_port;
	net_ipaddr_copy(&request->peer.sin6_addr, &peer.sin6_addr);

	request->id = coap_next_id();
	request->count = 1;
	request->type = type;
	request->cb = cb;
	request->user_data = user_data;
	request->used = true;

	k_delayed_work_init(&request->timer, request_timeout);

	switch (type) {
	case COAP_REQ_NONE:
		return;
	case COAP_REQ_LED_ON:
		request->code = COAP_RESPONSE_CODE_CHANGED;
		set_led_on(&request->peer, request->id);
		break;
	case COAP_REQ_LED_OFF:
		request->code = COAP_RESPONSE_CODE_CHANGED;
		set_led_off(&request->peer, request->id);
		break;
	case COAP_REQ_RPL_INFO:
		request->code = COAP_RESPONSE_CODE_CONTENT;
		get_rpl_info(&request->peer, request->id);
		break;
	case COAP_REQ_RPL_OBS:
		request->code = COAP_RESPONSE_CODE_CONTENT;
		add_node_to_topology(peer_addr);
		set_rpl_observer(&request->peer, request->id);
	}

	k_delayed_work_submit(&request->timer, RESPONSE_TIME);
}

int coap_init(void)
{
	struct net_if *iface = NULL;

	static struct sockaddr_in6 my_addr = {
			.sin6_family = AF_INET6,
			.sin6_port = htons(MY_COAP_PORT)
			};
	u8_t i;
	int r;

	iface = net_if_get_ieee802154();
	if (!iface) {
		NET_ERR("No IEEE 802.15.4 network interface found.");
		return -EINVAL;
	}

	for (i = 0; i < NET_IF_MAX_IPV6_ADDR; i++) {
		if (iface->config.ip.ipv6->unicast[i].is_used) {
			break;
		}
	}

	if (i >= NET_IF_MAX_IPV6_ADDR) {
		return -EINVAL;
	}

	net_ipaddr_copy(&my_addr.sin6_addr,
			&iface->config.ip.ipv6->unicast[i].address.in6_addr);

	add_nbr_to_topology(&my_addr.sin6_addr);

	r = net_context_get(AF_INET6, SOCK_DGRAM, IPPROTO_UDP, &coap);
	if (r < 0) {
		NET_ERR("Could not get UDP context");
		return r;
	}

	r = net_context_bind(coap, (struct sockaddr *) &my_addr,
			     sizeof(my_addr));
	if (r < 0) {
		NET_ERR("Could not bind to the context");
		return r;
	}

	r = net_context_recv(coap, pkt_receive, 0, NULL);
	if (r < 0) {
		NET_ERR("Could not set recv callback in the context");
		return r;
	}

	return 0;
}
```

## src/config.h
```c
/*
 * Copyright (c) 2017 Intel Corporation
 *
 * SPDX-License-Identifier: Apache-2.0
 */

#ifndef _CONFIG_H_
#define _CONFIG_H_

#include <net/coap.h>

/* The startup time needs to be longish if DHCP is enabled as setting
 * DHCP up takes some time.
 */
#define APP_STARTUP_TIME K_SECONDS(20)

bool setup_rpl(struct net_if *iface, const char *addr_prefix);

enum coap_request_type {
	COAP_REQ_NONE = 0,
	COAP_REQ_LED_ON = 1,	/* Turn On LED */
	COAP_REQ_LED_OFF = 2,	/* Turn Off LED */
	COAP_REQ_RPL_INFO = 3,	/* Get RPL Info */
	COAP_REQ_RPL_OBS = 4,	/* Register OBS */
};

struct network_topology {
	struct {
		bool used;
		u16_t id;
		u16_t rank;
		char label[4];
		struct in6_addr addr;
		struct in6_addr parent;
	} nodes[CONFIG_NET_IPV6_MAX_NEIGHBORS];

	struct {
		u16_t from;
		u16_t to;
		bool used;
	} edges[CONFIG_NET_IPV6_MAX_NEIGHBORS];
};

struct network_topology topology;

typedef void (*coap_reply_cb_t)(struct coap_packet *response, void *user_data);

int coap_init(void);
void coap_send_request(struct in6_addr *peer_addr,
		       enum coap_request_type type,
		       coap_reply_cb_t cb,
		       void *user_data);

void coap_remove_node_from_topology(struct in6_addr *peer);
#endif
```

## src/shell.c
```c
/*
 * Copyright (c) 2017 Intel Corporation
 *
 * SPDX-License-Identifier: Apache-2.0
 */

#if 1
#define SYS_LOG_DOMAIN "rpl-br/shell"
#define NET_SYS_LOG_LEVEL SYS_LOG_LEVEL_DEBUG
#define NET_LOG_ENABLED 1
#endif

#include <zephyr.h>
#include <shell/shell.h>
#include <stdio.h>

#include "../../../subsys/net/ip/rpl.h"

#include "config.h"

#define BR_SHELL_MODULE "br"

int br_repair(int argc, char *argv[])
{
	ARG_UNUSED(argc);
	ARG_UNUSED(argv);

	NET_INFO("Starting global repair...");

	net_rpl_repair_root(CONFIG_NET_RPL_DEFAULT_INSTANCE);

	return 0;
}

int coap_send(int argc, char *argv[])
{
	struct in6_addr peer_addr;
	enum coap_request_type type;
	int r;

	if (argc != 3 || !argv[1] || !argv[2]) {
		NET_INFO("Invalid arguments");
		return -EINVAL;
	}

	r = net_addr_pton(AF_INET6, argv[2], &peer_addr);
	if (r < 0) {
		return -EINVAL;
	}

	if (strcmp(argv[1], "toggle") == 0) {
		type = COAP_REQ_LED_TOGGLE;
	} else {
		NET_INFO("Invalid arguments");
		return -EINVAL;
	}

	coap_send_request(&peer_addr, type, NULL, NULL);

	return 0;
}

static struct shell_cmd br_commands[] = {
	/* Keep the commands in alphabetical order */
	{ "coap", coap_send, "\n\tSend CoAP commands to Node\n"
			"toggle <host> \n\tToggle the LED\n"
	},
	{ "repair", br_repair,
		"\n\tGlobal repair RPL network" },
	{ NULL, NULL, NULL }
};

SHELL_REGISTER(BR_SHELL_MODULE, br_commands);
```
