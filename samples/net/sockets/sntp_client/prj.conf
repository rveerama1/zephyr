## prj.conf
```kconfig
# General config
CONFIG_NEWLIB_LIBC=y

# Networking config
CONFIG_NETWORKING=y
CONFIG_NET_IPV4=y
CONFIG_NET_IPV6=y
CONFIG_NET_UDP=y
CONFIG_NET_SHELL=y

# Sockets
CONFIG_NET_SOCKETS=y
CONFIG_NET_SOCKETS_POSIX_NAMES=y
CONFIG_NET_SOCKETS_POLL_MAX=4

# Network driver config
CONFIG_TEST_RANDOM_GENERATOR=y

# Network address config
CONFIG_NET_CONFIG_SETTINGS=y
CONFIG_NET_CONFIG_NEED_IPV4=y
CONFIG_NET_CONFIG_NEED_IPV6=y
CONFIG_NET_CONFIG_MY_IPV4_ADDR="192.0.2.1"
CONFIG_NET_CONFIG_PEER_IPV4_ADDR="192.0.2.2"
CONFIG_NET_CONFIG_MY_IPV6_ADDR="2001:db8::1"
CONFIG_NET_CONFIG_PEER_IPV6_ADDR="2001:db8::2"

# Network debug config
CONFIG_NET_LOG=y
CONFIG_LOG=y

# SNTP
CONFIG_SNTP=y

#CONFIG_NET_SOCKETS_LOG_LEVEL_DBG=y
#CONFIG_SNTP_LOG_LEVEL_DBG=y

CONFIG_MAIN_STACK_SIZE=2048
```

## src/main.c
```c
/*
 * Copyright (c) 2017 Linaro Limited
 * Copyright (c) 2018 Intel Corporation
 *
 * SPDX-License-Identifier: Apache-2.0
 */

#include <zephyr.h>
#include <misc/printk.h>

#include <net/socket.h>
#include <net/net_ip.h>
#include <net/sntp.h>

#define SNTP_PORT 123

void resp_callback(struct sntp_ctx *ctx, int status,
		   u64_t epoch_time)
{
	printk("time: %lld\n", epoch_time);
	printk("status: %d\n", status);
}

void main(void)
{
	struct sntp_ctx ctx;
	struct sockaddr_in addr;
	struct sockaddr_in6 addr6;
	int rv;

	/* ipv4 */
	memset(&addr, 0, sizeof(addr));
	addr.sin_family = AF_INET;
	addr.sin_port = htons(SNTP_PORT);
	inet_pton(AF_INET, CONFIG_NET_CONFIG_PEER_IPV4_ADDR,
		  &addr.sin_addr);

	rv = sntp_init(&ctx, (struct sockaddr *) &addr,
		       sizeof(struct sockaddr_in));
	if (rv < 0) {
		printk("Failed to init sntp ctx: %d\n", rv);
		return;
	}

	rv = sntp_request(&ctx, K_FOREVER, resp_callback);
	if (rv < 0) {
		printk("Failed to send sntp request: %d\n", rv);
		goto end;
	}

	sntp_close(&ctx);

	/* ipv6 */
	memset(&addr6, 0, sizeof(addr6));
	addr6.sin6_family = AF_INET6;
	addr6.sin6_port = htons(SNTP_PORT);
	inet_pton(AF_INET6, CONFIG_NET_CONFIG_PEER_IPV6_ADDR,
		  &addr6.sin6_addr);

	rv = sntp_init(&ctx, (struct sockaddr *) &addr6,
		       sizeof(struct sockaddr_in6));
	if (rv < 0) {
		printk("Failed to initi sntp ctx: %d\n", rv);
		goto end;
	}

	rv = sntp_request(&ctx, K_NO_WAIT, resp_callback);
	if (rv < 0) {
		printk("Failed to send sntp request: %d\n", rv);
		goto end;
	}

end:
	sntp_close(&ctx);
}
```
