## samples/subsys/usb/cdc_acm/sample.yaml
```yaml
sample:
  name: CDC ACM USB
tests:
  test:
    depends_on: usb_device
    platform_whitelist: arduino_101 nrf52840_pca10056 frdm_k64f
    tags: usb
    harness: console
```
